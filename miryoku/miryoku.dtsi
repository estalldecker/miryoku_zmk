// Copyright 2022 Manna Harbour
// https://github.com/manna-harbour/miryoku

#include <behaviors.dtsi>
#include <dt-bindings/zmk/keys.h>
#include <dt-bindings/zmk/bt.h>
#include <dt-bindings/zmk/rgb.h>
#include <dt-bindings/zmk/outputs.h>
#include <dt-bindings/zmk/ext_power.h>

#include "miryoku.h"

#include <dt-bindings/zmk/mouse.h>

/ {
    combos {
        compatible = "zmk,combos";
        combo_one {
            timeout-ms = <50>;
            key-positions = <1 13>;
            bindings = <&kp N1>;
        };
        combo_two {
            timeout-ms = <50>;
            key-positions = <2 14>;
            bindings = <&kp N2>;
        };
        combo_three {
            timeout-ms = <50>;
            key-positions = <3 15>;
            bindings = <&kp N3>;
        };
        combo_four {
            timeout-ms = <50>;
            key-positions = <4 16>;
            bindings = <&kp N4>;
        };
        combo_five {
            timeout-ms = <50>;
            key-positions = <5 17>;
            bindings = <&kp N5>;
        };
        combo_six {
            timeout-ms = <50>;
            key-positions = <6 18>;
            bindings = <&kp N6>;
        };
        combo_seven {
            timeout-ms = <50>;
            key-positions = <7 19>;
            bindings = <&kp N7>;
        };
        combo_eight {
            timeout-ms = <50>;
            key-positions = <8 20>;
            bindings = <&kp N8>;
        };
        combo_nine {
            timeout-ms = <50>;
            key-positions = <9 21>;
            bindings = <&kp N9>;
        };
        combo_zero {
            timeout-ms = <50>;
            key-positions = <10 22>;
            bindings = <&kp N0>;
        };
        combo_esc {
            timeout-ms = <50>;
            key-positions = <1 2>;
            bindings = <&kp ESC>;
        };
        combo_at {
            timeout-ms = <50>;
            key-positions = <2 3>;
            bindings = <&kp AT_SIGN>;
        };        
    };
};

/ {
  keymap {
    compatible = "zmk,keymap";
#define MIRYOKU_X(LAYER, STRING) \
    LAYER { \
      label = STRING; \
      bindings = < U_MACRO_VA_ARGS(MIRYOKU_LAYERMAPPING_##LAYER, MIRYOKU_LAYER_##LAYER) >; \
    };
MIRYOKU_LAYER_LIST
#undef MIRYOKU_X
  };
};

#include "miryoku_shift_functions.dtsi"

#include "miryoku_double_tap_guard.dtsi"

#if defined (MIRYOKU_KLUDGE_MOUSEKEYSPR)
  #include "miryoku_kludge_mousekeyspr.dtsi"
#else
  #include "miryoku_mousekeys.dtsi"
#endif

#if defined (MIRYOKU_KLUDGE_THUMBCOMBOS)
  #include "miryoku_kludge_thumbcombos.dtsi"
#endif

#if defined (MIRYOKU_KLUDGE_TOPROWCOMBOS)
  #include "miryoku_kludge_toprowcombos.dtsi"
#endif

#if defined (MIRYOKU_KLUDGE_BOTTOMROWCOMBOS)
  #include "miryoku_kludge_bottomrowcombos.dtsi"
#endif

#if defined (MIRYOKU_KLUDGE_TAPDELAY)
  #include "miryoku_kludge_tapdelay.dtsi"
#else
  #include "miryoku_behaviors.dtsi"
#endif
