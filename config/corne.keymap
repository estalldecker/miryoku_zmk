// Copyright 2021 Manna Harbour
// https://github.com/manna-harbour/miryoku


/ {
    combos {
        compatible = "zmk,combos";
        combo_esc {
            timeout-ms = <50>;
            key-positions = <0 10>;
            bindings = <&kp N1>;
        };
    };
};

#include "../miryoku/custom_config.h"
#include "../miryoku/mapping/42/corne.h"
#include "../miryoku/miryoku.dtsi"
